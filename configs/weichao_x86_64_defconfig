## configs/weichao_x86_64_defconfig
```kconfig
BR2_x86_64=y
BR2_ENABLE_DEBUG=y
BR2_OPTIMIZE_G=y
BR2_ROOTFS_MERGED_USR=y
BR2_SYSTEM_DHCP="eth0"
BR2_SYSTEM_DEFAULT_PATH="/bin:/sbin:/usr/bin:/usr/sbin"
BR2_TARGET_TZ_INFO=y
BR2_ROOTFS_OVERLAY="board/weichao/x86/rootfs-overlay"
BR2_ROOTFS_POST_BUILD_SCRIPT="board/weichao/x86/post_build_target.sh"
BR2_ROOTFS_POST_IMAGE_SCRIPT="board/weichao/x86/post-image.sh"
BR2_LINUX_KERNEL=y
BR2_LINUX_KERNEL_USE_CUSTOM_CONFIG=y
BR2_LINUX_KERNEL_CUSTOM_CONFIG_FILE="../linux/arch/x86/configs/weichao_x86_64_defconfig"
BR2_PACKAGE_BUSYBOX_SHOW_OTHERS=y
BR2_PACKAGE_INTREE_EPOLL=y
BR2_PACKAGE_INTREE_HELLO=y
BR2_PACKAGE_E2FSPROGS=y
BR2_PACKAGE_LINUX_FIRMWARE=y
BR2_PACKAGE_LINUX_FIRMWARE_MEDIATEK_MT7921=y
BR2_PACKAGE_DBUS=y
BR2_PACKAGE_KBD=y
BR2_PACKAGE_GNUTLS=y
BR2_PACKAGE_LIBCURL=y
BR2_PACKAGE_LIBCURL_CURL=y
BR2_PACKAGE_LIBCURL_VERBOSE=y
BR2_PACKAGE_LIBCURL_TLS_NONE=y
BR2_PACKAGE_CMOCKA=y
BR2_PACKAGE_ELFUTILS=y
BR2_PACKAGE_LIBCAP=y
BR2_PACKAGE_POPT=y
BR2_PACKAGE_NETCAT=y
BR2_PACKAGE_OPENSSH=y
BR2_PACKAGE_BASH=y
BR2_PACKAGE_KMOD=y
BR2_PACKAGE_KMOD_TOOLS=y
BR2_PACKAGE_UTIL_LINUX_BINARIES=y
BR2_PACKAGE_UTIL_LINUX_AGETTY=y
BR2_PACKAGE_UTIL_LINUX_FSCK=y
BR2_PACKAGE_UTIL_LINUX_MOUNT=y
BR2_TARGET_ROOTFS_CPIO=y
BR2_TARGET_ROOTFS_CPIO_GZIP=y
BR2_TARGET_ROOTFS_EXT2=y
BR2_TARGET_ROOTFS_EXT2_4=y
BR2_TARGET_ROOTFS_EXT2_SIZE="1000M"
BR2_PACKAGE_HOST_GENIMAGE=y
```

## configs/weichao_x86_defconfig
```kconfig
BR2_x86_64=y
BR2_ENABLE_DEBUG=y
BR2_OPTIMIZE_G=y
BR2_SYSTEM_DHCP="eth0"
BR2_ROOTFS_OVERLAY="board/weichao/x86/rootfs-overlay"
BR2_ROOTFS_POST_BUILD_SCRIPT="board/weichao/x86/post_build_target.sh"
BR2_LINUX_KERNEL=y
BR2_LINUX_KERNEL_USE_CUSTOM_CONFIG=y
# 始终都用linux/.config
# BR2_LINUX_KERNEL_CUSTOM_CONFIG_FILE="$(LINUX_DIR)/.config"
BR2_LINUX_KERNEL_CUSTOM_CONFIG_FILE="../linux/arch/x86/configs/weichao_x86_64_defconfig"
BR2_PACKAGE_E2FSPROGS=y
BR2_PACKAGE_GNUTLS=y
BR2_PACKAGE_LIBCURL=y
BR2_PACKAGE_LIBCURL_CURL=y
BR2_PACKAGE_LIBCURL_VERBOSE=y
BR2_PACKAGE_LIBCURL_TLS_NONE=y
BR2_PACKAGE_LIBTIRPC=y
BR2_PACKAGE_CMOCKA=y
BR2_PACKAGE_ELFUTILS=y
BR2_PACKAGE_POPT=y
BR2_PACKAGE_OPENSSH=y
BR2_TARGET_ROOTFS_CPIO=y
# BR2_TARGET_ROOTFS_TAR is not set
BR2_PACKAGE_HOST_E2FSPROGS=y
```

## package/intree/Config.in
```kconfig
menuconfig BR2_PACKAGE_INTREE
	bool "intree"
	help
	  intree binary
if BR2_PACKAGE_INTREE
config BR2_PACKAGE_INTREE_EPOLL
	bool "epoll"
	help
	  simple epoll tcp server

config BR2_PACKAGE_INTREE_HELLO
    bool "hello"
	help
	  hello world
endif
```
